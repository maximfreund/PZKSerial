// =============================================================================
//  PilzkulturSound · Wi-Fi remote for the Behringer Ultradrive Pro DCX2496
//
//  An ESP32 opens its own hotspot (and/or joins your Wi-Fi), serves the web UI
//  and bridges it to the DCX2496 over RS-232.
//
//  Based on DuinoDCX by Lasse Lukkari (MIT): github.com/lasselukkari/DuinoDCX
//  Requires the ESP32 Arduino core 3.x. Settings: see Config.h
// =============================================================================
#include "Config.h"

#include <ESPmDNS.h>
#include <Preferences.h>
#include <Update.h>
#include <WiFi.h>
#include <esp_wifi.h>

#include "aWOT.h"
#include "Json.h"
#include "Ultradrive.h"
#include "StaticFiles.h"  // generated by `npm run build`; needs aWOT.h first

Preferences preferences;
WiFiServer httpServer(80);
HardwareSerial dcxSerial(2);
Ultradrive dcx(&dcxSerial, RTS_PIN, CTS_PIN);
Application app;
Router apiRouter("/api");

// ---- Settings (loaded from NVS at boot) -------------------------------------
char basicAuth[AUTH_LENGTH];
char softApSsid[SSID_LENGTH];
char softApPassword[PASSWORD_LENGTH];
char mdnsName[MDNS_NAME_LENGTH];
bool flowControl;
bool autoDisableAP;

// ---- Runtime state ----------------------------------------------------------
char authBuffer[AUTH_LENGTH];
bool shouldRestart = false;
unsigned long requestStart;
unsigned long lastConnected;

// =============================================================================
//  Helpers
// =============================================================================

// Copies a form value into a fixed buffer; fails instead of truncating.
bool copyValue(char *destination, size_t size, const char *value) {
  if (strlen(value) >= size) {
    return false;
  }
  strcpy(destination, value);
  return true;
}

bool isValidSsid(const char *ssid) {
  size_t length = strlen(ssid);
  return length > 0 && length < SSID_LENGTH;
}

// Empty means an open hotspot; otherwise WPA2 needs 8–64 characters.
bool isValidApPassword(const char *password) {
  size_t length = strlen(password);
  return length == 0 || (length >= MIN_WPA2_PASSWORD_LENGTH && length < PASSWORD_LENGTH);
}

// Waits for the Wi-Fi connection while keeping the RS-232 link serviced.
bool waitForWifi(unsigned long timeout) {
  unsigned long start = millis();

  while (WiFi.status() != WL_CONNECTED && millis() - start < timeout) {
    dcx.processIncoming(millis());
    delay(50);
  }

  return WiFi.status() == WL_CONNECTED;
}

bool hasSavedNetwork() {
  wifi_config_t config;
  return esp_wifi_get_config(WIFI_IF_STA, &config) == ESP_OK && config.sta.ssid[0] != 0;
}

const char *methodName(Request::MethodType method) {
  switch (method) {
    case Request::GET:
      return "GET";
    case Request::HEAD:
      return "HEAD";
    case Request::POST:
      return "POST";
    case Request::PUT:
      return "PUT";
    case Request::PATCH:
      return "PATCH";
    case Request::DELETE:
      return "DELETE";
    case Request::OPTIONS:
      return "OPTIONS";
    default:
      return "?";
  }
}

// =============================================================================
//  Middleware
// =============================================================================

void logRequestStart(Request &req, Response &res) {
  requestStart = micros();
  Serial.printf("%lu: HTTP %s %s ", millis(), methodName(req.method()), req.path());
}

void logRequestEnd(Request &req, Response &res) {
  Serial.printf("%d b %.2f ms\n", res.bytesSent(), (micros() - requestStart) / 1000.0);
}

void auth(Request &req, Response &res) {
  const char *header = req.get("Authorization");

  if (header && strcmp(header, basicAuth) == 0) {
    return;
  }

  Serial.println("401");
  res.set("WWW-Authenticate", "Basic realm=\"" BRAND_NAME "\"");
  res.sendStatus(401);
  res.end();
}

// =============================================================================
//  API: device
// =============================================================================

// GET /api/state → [selected id][dump part 0 + 1, if in sync][search responses…]
void getState(Request &req, Response &res) {
  res.set("Content-Type", "application/octet-stream");
  res.write(dcx.getSelected());
  dcx.writeDevice(&res);
  dcx.writeDevices(&res);
}

// GET /api/status → level meters of the selected device
void getStatus(Request &req, Response &res) {
  res.set("Content-Type", "application/octet-stream");
  dcx.writeDeviceStatus(&res);
}

// PUT /api/selected  body: device id as text
void selectDevice(Request &req, Response &res) {
  char body[8] = {0};
  size_t length = req.readBytes(body, sizeof(body) - 1);
  char *end;
  long id = strtol(body, &end, 10);

  if (!length || end == body || !dcx.setSelected(id)) {
    return res.sendStatus(400);
  }

  res.sendStatus(204);
}

// POST /api/commands  body: raw DCX parameter change frames
void createDirectCommand(Request &req, Response &res) {
  while (req.left()) {
    int left = req.left();
    dcx.processOutgoing(&req);

    if (req.left() == left) {
      return res.sendStatus(408);  // client stalled or vanished mid-request
    }
  }

  res.sendStatus(204);
}

// =============================================================================
//  API: Wi-Fi connection
// =============================================================================

void getConnection(Request &req, Response &res) {
  res.set("Content-Type", "application/json");
  JsonObject json(res);
  json.add("current", WiFi.SSID().c_str()).add("ip", WiFi.localIP().toString().c_str());
}

void updateConnection(Request &req, Response &res) {
  char name[FORM_NAME_LENGTH];
  char value[PASSWORD_LENGTH];
  char ssid[SSID_LENGTH] = "";
  char password[PASSWORD_LENGTH] = "";

  while (req.left()) {
    if (!req.form(name, sizeof(name), value, sizeof(value))) {
      return res.sendStatus(400);
    }

    bool ok = false;
    if (strcmp(name, POST_PARAM_SSID_KEY) == 0) {
      ok = copyValue(ssid, sizeof(ssid), value);
    } else if (strcmp(name, POST_PARAM_PASSWORD_KEY) == 0) {
      ok = copyValue(password, sizeof(password), value);
    }

    if (!ok) {
      return res.sendStatus(400);
    }
  }

  if (!ssid[0]) {
    return res.sendStatus(400);
  }

  Serial.printf("Joining \"%s\"...\n", ssid);
  WiFi.disconnect(false, true);
  WiFi.begin(ssid, password);

  if (!waitForWifi(CONNECTION_TIMEOUT)) {
    Serial.println("Could not join the network");
    WiFi.disconnect(false, true);
    return res.sendStatus(400);
  }

  lastConnected = millis();
  getConnection(req, res);
}

void removeConnection(Request &req, Response &res) {
  if (!WiFi.disconnect(false, true)) {
    return res.sendStatus(500);
  }

  res.sendStatus(204);
}

void getNetworks(Request &req, Response &res) {
  int count = WiFi.scanNetworks();
  res.set("Content-Type", "application/json");

  {
    JsonArray json(res);

    for (int i = 0; i < count; i++) {
      String ssid = WiFi.SSID(i);
      bool duplicate = ssid.isEmpty();  // skip hidden networks, too

      for (int j = 0; j < i && !duplicate; j++) {
        duplicate = WiFi.SSID(j) == ssid;
      }

      if (!duplicate) {
        json.add(ssid.c_str());
      }
    }
  }

  WiFi.scanDelete();
}

// =============================================================================
//  API: settings & firmware
// =============================================================================

void getSettings(Request &req, Response &res) {
  res.set("Content-Type", "application/json");
  JsonObject json(res);
  json.add(SOFT_AP_SSID_KEY, softApSsid)
      .add(SOFT_AP_PASSWORD_KEY, softApPassword)
      .add(AUTH_KEY, basicAuth)
      .add(MDNS_HOST_KEY, mdnsName)
      .add(FLOW_CONTROL_KEY, flowControl ? "1" : "0")
      .add(AUTO_DISABLE_AP_KEY, autoDisableAP ? "1" : "0");
}

// Validates everything first, so a bad request can't leave half-saved settings
// or a hotspot that refuses to start.
void updateSettings(Request &req, Response &res) {
  char name[FORM_NAME_LENGTH];
  char value[AUTH_LENGTH];

  char newAuth[AUTH_LENGTH] = "";
  char newSsid[SSID_LENGTH] = "";
  char newPassword[PASSWORD_LENGTH] = "";
  char newMdnsName[MDNS_NAME_LENGTH] = "";
  bool hasAuth = false, hasSsid = false, hasPassword = false, hasMdnsName = false;
  int newFlowControl = -1, newAutoDisableAP = -1;

  while (req.left()) {
    if (!req.form(name, sizeof(name), value, sizeof(value))) {
      return res.sendStatus(400);
    }

    bool ok = true;
    if (strcmp(name, AUTH_KEY) == 0) {
      ok = hasAuth = copyValue(newAuth, sizeof(newAuth), value) && newAuth[0];
    } else if (strcmp(name, SOFT_AP_SSID_KEY) == 0) {
      ok = hasSsid = copyValue(newSsid, sizeof(newSsid), value) && isValidSsid(newSsid);
    } else if (strcmp(name, SOFT_AP_PASSWORD_KEY) == 0) {
      ok = hasPassword = copyValue(newPassword, sizeof(newPassword), value) && isValidApPassword(newPassword);
    } else if (strcmp(name, MDNS_HOST_KEY) == 0) {
      ok = hasMdnsName = copyValue(newMdnsName, sizeof(newMdnsName), value) && newMdnsName[0];
    } else if (strcmp(name, FLOW_CONTROL_KEY) == 0) {
      newFlowControl = value[0] != '0';
    } else if (strcmp(name, AUTO_DISABLE_AP_KEY) == 0) {
      newAutoDisableAP = value[0] != '0';
    } else {
      ok = false;
    }

    if (!ok) {
      Serial.printf("Rejected setting \"%s\"\n", name);
      return res.sendStatus(400);
    }
  }

  preferences.begin(PREFERENCES_NAMESPACE, false);
  if (hasAuth) preferences.putString(AUTH_KEY, newAuth);
  if (hasSsid) preferences.putString(SOFT_AP_SSID_KEY, newSsid);
  if (hasPassword) preferences.putString(SOFT_AP_PASSWORD_KEY, newPassword);
  if (hasMdnsName) preferences.putString(MDNS_HOST_KEY, newMdnsName);
  if (newFlowControl >= 0) preferences.putBool(FLOW_CONTROL_KEY, newFlowControl);
  if (newAutoDisableAP >= 0) preferences.putBool(AUTO_DISABLE_AP_KEY, newAutoDisableAP);
  preferences.end();

  Serial.println("Settings saved - restarting");
  res.sendStatus(204);
  shouldRestart = true;
}

void getVersion(Request &req, Response &res) {
  res.set("Content-Type", "application/json");
  JsonObject json(res);
  json.add("version", VERSION).add("buildDate", BUILD_DATE);
}

// POST /api/update  body: firmware .bin
void update(Request &req, Response &res) {
  int contentLength = req.left();

  bool ok = contentLength > 0 &&
            Update.begin(contentLength) &&
            Update.writeStream(req) == (size_t)contentLength &&
            Update.end() &&
            Update.isFinished();

  if (!ok) {
    Update.printError(Serial);
    Update.abort();
    return res.sendStatus(500);
  }

  Serial.println("Firmware updated - restarting");
  res.sendStatus(204);
  shouldRestart = true;
}

// =============================================================================
//  Setup
// =============================================================================

bool factoryResetRequested() {
  pinMode(RESET_PIN, INPUT_PULLUP);
  unsigned long start = millis();

  while (digitalRead(RESET_PIN) == LOW) {
    if (millis() - start > FACTORY_RESET_HOLD) {
      return true;
    }
    delay(10);
  }

  return false;
}

void loadString(const char *key, char *buffer, size_t size, const char *fallback) {
  if (!preferences.getString(key, buffer, size)) {
    strlcpy(buffer, fallback, size);
  }
}

void loadPreferences() {
  preferences.begin(PREFERENCES_NAMESPACE, false);

  if (factoryResetRequested()) {
    Serial.println("Factory reset: restoring default settings");
    preferences.clear();
  }

  loadString(AUTH_KEY, basicAuth, sizeof(basicAuth), DEFAULT_AUTH);
  loadString(SOFT_AP_SSID_KEY, softApSsid, sizeof(softApSsid), DEFAULT_SOFT_AP_SSID);
  loadString(SOFT_AP_PASSWORD_KEY, softApPassword, sizeof(softApPassword), DEFAULT_SOFT_AP_PASSWORD);
  loadString(MDNS_HOST_KEY, mdnsName, sizeof(mdnsName), DEFAULT_MDNS_NAME);
  flowControl = preferences.getBool(FLOW_CONTROL_KEY, DEFAULT_FLOW_CONTROL);
  autoDisableAP = preferences.getBool(AUTO_DISABLE_AP_KEY, DEFAULT_AUTO_DISABLE_AP);

  preferences.end();
}

void startAccessPoint() {
  if (!WiFi.softAP(softApSsid, softApPassword)) {
    // Saved settings the radio won't accept must never lock us out.
    Serial.println("Hotspot settings rejected - falling back to factory defaults");
    strlcpy(softApSsid, DEFAULT_SOFT_AP_SSID, sizeof(softApSsid));
    strlcpy(softApPassword, DEFAULT_SOFT_AP_PASSWORD, sizeof(softApPassword));
    WiFi.softAP(softApSsid, softApPassword);
  }

  Serial.printf("Hotspot \"%s\" -> http://%s\n", softApSsid, WiFi.softAPIP().toString().c_str());
}

void setupWifi() {
  WiFi.setHostname(mdnsName);
  WiFi.begin();  // join the saved network, if there is one

  bool connected = hasSavedNetwork() && waitForWifi(CONNECTION_TIMEOUT);

  if (connected) {
    Serial.printf("Wi-Fi \"%s\" -> http://%s\n", WiFi.SSID().c_str(), WiFi.localIP().toString().c_str());
  } else {
    WiFi.disconnect(false, false);  // stop retrying; keeps the hotspot channel stable
  }

  lastConnected = millis();

  if (!connected || !autoDisableAP) {
    startAccessPoint();
  }
}

void setupHttpServer() {
  app.header("Authorization", authBuffer, AUTH_LENGTH);

  apiRouter.get("/state", &getState);
  apiRouter.get("/status", &getStatus);
  apiRouter.put("/selected", &selectDevice);
  apiRouter.post("/commands", &createDirectCommand);
  apiRouter.get("/connection", &getConnection);
  apiRouter.patch("/connection", &updateConnection);
  apiRouter.del("/connection", &removeConnection);
  apiRouter.get("/settings", &getSettings);
  apiRouter.patch("/settings", &updateSettings);
  apiRouter.get("/networks", &getNetworks);
  apiRouter.post("/update", &update);
  apiRouter.get("/version", &getVersion);

  app.use(&logRequestStart);
  app.use(&auth);
  app.route(&apiRouter);
  app.route(staticFiles());
  app.use(&logRequestEnd);

  httpServer.begin();
}

void setupMdns() {
  if (MDNS.begin(mdnsName)) {
    MDNS.addService("http", "tcp", 80);
    Serial.printf("mDNS -> http://%s.local\n", mdnsName);
  } else {
    Serial.println("mDNS failed to start");
  }
}

void setup() {
  Serial.begin(CONSOLE_BAUD);
  Serial.printf("\n\n%s %s - built %s\n", BRAND_NAME, VERSION, BUILD_DATE);

  dcxSerial.setRxBufferSize(ULTRADRIVE_RX_BUFFER);  // must happen before begin()
  dcxSerial.begin(ULTRADRIVE_BAUD, SERIAL_8N1, RX2_PIN, TX2_PIN);

  loadPreferences();

  if (flowControl) {
    pinMode(RTS_PIN, OUTPUT);
    pinMode(CTS_PIN, INPUT_PULLUP);
    dcx.enableFlowControl(true);
  }

  setupWifi();
  setupHttpServer();
  setupMdns();
}

// =============================================================================
//  Loop
// =============================================================================

void processWebServer() {
  WiFiClient client = httpServer.accept();

  if (client.connected()) {
    app.process(&client);
  }
}

// With "auto-disable AP" the hotspot is off while the Wi-Fi network works.
// If that network disappears, bring the hotspot back so we stay reachable.
void keepReachable(unsigned long now) {
  static unsigned long lastCheck = 0;
  if (now - lastCheck < 1000) {
    return;
  }
  lastCheck = now;

  if (WiFi.status() == WL_CONNECTED) {
    lastConnected = now;
  } else if (!(WiFi.getMode() & WIFI_MODE_AP) && now - lastConnected >= RECONNECT_INTERVAL) {
    Serial.println("Wi-Fi network lost - re-opening the hotspot");
    startAccessPoint();
  }
}

void restartIfNeeded() {
  if (shouldRestart) {
    delay(RESTART_DELAY);
    ESP.restart();
  }
}

void loop() {
  unsigned long now = millis();
  dcx.processIncoming(now);
  processWebServer();
  keepReachable(now);
  restartIfNeeded();
}
